## drivers/adc/Kconfig
```kconfig
#
# ADC subsystem configuration
#

menuconfig ADC
	bool "ADC support"
        #depends on PLAT_RK
	default y
if ADC

#source drivers/adc/plat/Kconfig

config ADC_FIREFLY
        tristate "Firefly ADC Demo support"
        default y
        help
          Sample code of ADC .


endif # ADC
```

## drivers/net/wireless/rockchip_wlan/Kconfig
```kconfig
menuconfig WL_ROCKCHIP
	bool "Rockchip Wireless LAN support"
	---help---
	  Enable compatible Wifi drivers for Rockchip platform.

if WL_ROCKCHIP

config WIFI_LOAD_DRIVER_WHEN_KERNEL_BOOTUP
	bool "Wifi load driver when kernel bootup"
	default y
	---help---
	  Wifi driver will be load (use late_initcall) when kernel bootup

source "drivers/net/wireless/rockchip_wlan/rkwifi/Kconfig"
source "drivers/net/wireless/rockchip_wlan/rtl8188eu/Kconfig"

menuconfig SET_FW_NVRAM_PATH
	bool "Set fw & nvram file path"
	default n

if SET_FW_NVRAM_PATH

config BCMDHD_FW_PATH
	string "Firmware path"
	default "/lib/firmware/fw_bcm4356a2_ag.bin"
	---help---
	  Path to the firmware file.

config BCMDHD_NVRAM_PATH
	string "NVRAM path"
	default "/lib/firmware/nvram_ap6356s.txt"
	---help---
	  Path to the calibration file.

endif # SET_FW_NVRAM_PATH

endif # WL_ROCKCHIP
```
